#include <dt-bindings/zmk/matrix_transfrom.h>

/ {
    chosen {
        zmk,ksacn = &default_ksan;
        zmk,matrix_transform = &default_transform;
    };

    default_ksacn: ksacn {
        compatible = "zmk,kscan-gpio-matrix";
        label = "default_kscan";
        diode-direction = "col2row";

        row-gpios = <&pro_mirco 19 GPIO_ACTIVE_HIGH | GPIO_ACTIVE_DOWN >,
                    <&pro_mirco 18 GPIO_ACTIVE_HIGH | GPIO_ACTIVE_DOWN >,
                    <&pro_mirco 15 GPIO_ACTIVE_HIGH | GPIO_ACTIVE_DOWN >,
                    <&pro_mirco 14 GPIO_ACTIVE_HIGH | GPIO_ACTIVE_DOWN >,
                    <&pro_mirco 16 GPIO_ACTIVE_HIGH | GPIO_ACTIVE_DOWN >,
                    <&pro_mirco 10 GPIO_ACTIVE_HIGH | GPIO_ACTIVE_DOWN >,

        col-gpios = <&pro_mirco 2 GPIO_ACTIVE_HIGH>,
                    <&pro_mirco 3 GPIO_ACTIVE_HIGH>,
                    <&pro_mirco 4 GPIO_ACTIVE_HIGH>,
                    <&pro_mirco 5 GPIO_ACTIVE_HIGH>,
                    <&pro_mirco 6 GPIO_ACTIVE_HIGH>,
                    <&pro_mirco 7 GPIO_ACTIVE_HIGH>;
    };

    default_transform: matrix_transform {
        compatible = "zmk,matrix-transform";
        rows = <6>;
        colums = <6>;

        maps = <
            RC(0,0) RC(0,1) RC(0,2) RC(0,3) RC(0,4) RC(0,5)
            RC(1,0) RC(1,1) RC(1,2) RC(1,3) RC(1,4) RC(1,5)
            RC(2,0) RC(2,1) RC(2,2) RC(2,3) RC(2,4) RC(2,5)
            RC(3,0) RC(3,1) RC(3,2) RC(3,3) RC(3,4) RC(3,5)
            RC(4,0) RC(4,1) RC(4,2) RC(4,3) RC(4,4) RC(4,5)
            RC(5,0) RC(5,1) RC(5,2) RC(5,3) RC(5,4) RC(5,5)
        >;
    };
};